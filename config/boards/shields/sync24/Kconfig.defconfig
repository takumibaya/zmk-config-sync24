## config/boards/shields/sync24/Kconfig.defconfig
```kconfig
# Copyright (c) 2025 The ZMK Contributors
# SPDX-License-Identifier: MIT

if SHIELD_SYNC24_LEFT

config ZMK_KEYBOARD_NAME
    default "SYNC24"
    
config ZMK_SPLIT_ROLE_CENTRAL
    default y

endif

if SHIELD_SYNC24_LEFT || SHIELD_SYNC24_RIGHT

config ZMK_SPLIT
    default y

config ZMK_STUDIO
    default y

endif
```

## config/boards/shields/sync24/Kconfig.shield
```kconfig
# Copyright (c) 2025 The ZMK Contributors
# SPDX-License-Identifier: MIT

config SHIELD_SYNC24_LEFT
    def_bool $(shields_list_contains,sync24_left)

config SHIELD_SYNC24_RIGHT
    def_bool $(shields_list_contains,sync24_right)
```
